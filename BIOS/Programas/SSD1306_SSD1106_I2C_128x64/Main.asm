#include "../Z80MiniAPI.asm"

; ==========================================================================
; Driver SH1106 / SSD1306 (OLED 128x64) via I2C - Z80Mini
;
; Baseado no mesmo padrao I2C_Open/I2C_Write/I2C_Close usado no driver
; SSD1306 do repositorio (BIOS/Programas/Display oled ssd1306_128x32).
;
; Compativel com os dois chips atraves do switch CHIP_SH1106 abaixo.
; Os dois usam "page addressing mode" aqui (comum aos dois controladores),
; entao o unico codigo que realmente muda entre eles e:
;   - o comando de charge pump (SH1106: $AD,$8B / SSD1306: $8D,$14)
;   - o COL_OFFSET (SH1106 tem RAM de 132 colunas mas painel de 128 ->
;     desloca 2; SSD1306 e nativamente 128 colunas -> offset 0)
; Tudo o mais (comandos de pagina/coluna, remap, scan direction, etc.)
; e identico nos dois chips.
; ==========================================================================

CHIP_SH1106 .equ    0           ; 1 = compila para SH1106, 0 = compila para SSD1306
CHIP_FLIP	.equ	1			; 0 = Display normal, 1 = Display flip 

oled        .equ    $78         ; endereco I2C (0x3C << 1), ja com bit R/W
SCR_WIDTH   .equ    128
SCR_PAGES   .equ    8           ; 128x64 -> 8 paginas de 8 pixels

#if CHIP_SH1106
COL_OFFSET  .equ    2           ; SH1106: RAM de 132 col, painel usa so 128 (offset 2)
#else
COL_OFFSET  .equ    0           ; SSD1306: 128 colunas nativas, sem offset
#endif

    .org $8000


; --------------------------------------------------------------------------
; Ponto de entrada de teste
; --------------------------------------------------------------------------
inicio:
    CALL SH1106_Init
    CALL SH1106_ClearAll

    LD A,0
    CALL SH1106_SetPage
    LD HL, MSG1
    CALL printStringHL

    LD A,1
    CALL SH1106_SetPage
    LD HL, MSG2
    CALL printStringHL

    LD A,2
    CALL SH1106_SetPage
    LD HL, MSG3
    CALL printStringHL

    LD A,3
    CALL SH1106_SetPage
    LD HL, MSG4
    CALL printStringHL

    LD A,4
    CALL SH1106_SetPage
    LD HL, MSG5
    CALL printStringHL

    LD A,5
    CALL SH1106_SetPage
    LD HL, MSG6
    CALL printStringHL

    LD A,6
    CALL SH1106_SetPage
    LD HL, MSG7
    CALL printStringHL

    LD A,7
    CALL SH1106_SetPage
    LD HL, MSG8
    CALL printStringHL

    RET
loop:
    CALL keyboardWaitA
    JP   loop


MSG1:	.db "|===================|", 0
MSG2:	.db "| ..:: Z80Mini ::.. |", 0
MSG3:	.db "| ----------------- |", 0
MSG4:	.db "| 32Kb ROM 0000-7FFF|", 0
MSG5:	.db "| 32Kb RAM 8000-FFFF|", 0
MSG6:	.db "| Serial 115200     |", 0
MSG7:	.db "| Keyboard and GLCD |", 0
MSG8:	.db "|===================|", 0

printStringHL:
	LD A, (HL)
	CP 0
	RET Z
	PUSH HL
	CALL printCharA
	POP HL
	INC HL
	JP printStringHL

	RET

printCharA:
	LD HL, FONT
	LD DE, $0000
	LD E, A
	ADD HL, DE
	ADD HL, DE
	ADD HL, DE
	ADD HL, DE
	ADD HL, DE
	ADD HL, DE
    LD   A, $40    ; control byte: fluxo de dados
    LD   B, 6      ; largura da fonte
    CALL send_i2c_block
    RET


; --------------------------------------------------------------------------
; SH1106_Init - inicializa o display
;   Entrada: nenhuma
;   Saida:   BC DE HL preservados
; --------------------------------------------------------------------------
SH1106_Init:
    LD   A, $AE         ; display off
    CALL send_cmd

    LD   A, $D5         ; clock divide ratio / oscillator freq
    CALL send_cmd
    LD   A, $80
    CALL send_cmd

    LD   A, $A8         ; multiplex ratio
    CALL send_cmd
    LD   A, $3F         ; 64 linhas (MUX = 63)
    CALL send_cmd

    LD   A, $D3         ; display offset
    CALL send_cmd
    LD   A, $00
    CALL send_cmd

    LD   A, $40         ; start line = 0
    CALL send_cmd

#if CHIP_SH1106
    LD   A, $AD         ; DC-DC control (charge pump do SH1106)
    CALL send_cmd
    LD   A, $8B         ; DC-DC on
    CALL send_cmd
#else
    LD   A, $8D         ; charge pump setting (SSD1306)
    CALL send_cmd
    LD   A, $14         ; charge pump on (usa VDD interno)
    CALL send_cmd
#endif

#if CHIP_FLIP
    LD   A, $A0         ; segment remap normal
    CALL send_cmd

    LD   A, $C0         ; COM scan normal 
    CALL send_cmd
#else
    LD   A, $A1         ; segment remap (espelha horizontal)
    CALL send_cmd

    LD   A, $C8         ; COM output scan direction (espelha vertical)
    CALL send_cmd
#endif

    LD   A, $DA         ; COM pins hardware config
    CALL send_cmd
    LD   A, $12
    CALL send_cmd

    LD   A, $81         ; contrast
    CALL send_cmd
    LD   A, $80
    CALL send_cmd

    LD   A, $D9         ; pre-charge period
    CALL send_cmd
    LD   A, $1F
    CALL send_cmd

    LD   A, $DB         ; VCOM deselect level
    CALL send_cmd
    LD   A, $40
    CALL send_cmd

    LD   A, $A4         ; entire display resume (mostra conteudo da RAM)
    CALL send_cmd

    LD   A, $A6         ; display normal (nao invertido)
    CALL send_cmd

    CALL delay_50ms

    LD   A, $AF         ; display on
    CALL send_cmd

    RET


; --------------------------------------------------------------------------
; SH1106_SetPage - seleciona pagina (0-7) e volta o cursor de coluna
; para o inicio (respeitando COL_OFFSET)
;   Entrada: A = numero da pagina (0-7)
;   Saida:   HL preservado
; Os 3 bytes de comando (pagina, coluna baixa, coluna alta) sao montados
; em PAGE_CMD e enviados numa unica transacao I2C.
; --------------------------------------------------------------------------
SH1106_SetPage:
    PUSH HL
    OR   $B0             ; comando "set page address" = $B0 | page
    LD   (PAGE_CMD), A

    LD   A, COL_OFFSET
    AND  $0F
    LD   (PAGE_CMD+1), A ; coluna baixa (nibble baixo, comando $00-$0F)

    LD   A, COL_OFFSET
    RRCA
    RRCA
    RRCA
    RRCA
    AND  $0F
    OR   $10
    LD   (PAGE_CMD+2), A ; coluna alta (nibble alto, comando $10-$1F)

    LD   HL, PAGE_CMD
    LD   A, $00           ; control byte: fluxo de comandos
    LD   B, 3
    CALL send_i2c_block

    POP  HL
    RET


; --------------------------------------------------------------------------
; SH1106_ClearAll - apaga a tela inteira (todas as 8 paginas, 128 colunas)
; Cada pagina e enviada como um unico bloco de 128 bytes zerados
; (1 Open/Close por pagina, em vez de 1 por byte).
; --------------------------------------------------------------------------
SH1106_ClearAll:
    LD   C, 0             ; contador de paginas
SH1106_ClearPage:
    LD   A, C
    CALL SH1106_SetPage

    LD   HL, ZERO_ROW
    LD   A, $40            ; control byte: fluxo de dados
    LD   B, SCR_WIDTH
    CALL send_i2c_block

    INC  C
    LD   A, C
    CP   SCR_PAGES
    JR   NZ, SH1106_ClearPage

    RET


; --------------------------------------------------------------------------
; send_i2c_block - envia um control byte seguido de varios bytes numa
; UNICA transacao I2C (1 Open/Close para o bloco inteiro).
;
;   Entrada: A  = control byte ($00 = comandos, $40 = dados)
;            HL = ponteiro para os bytes a enviar
;            B  = quantidade de bytes
;   Saida:   HL += B (avancado ate o fim do bloco enviado)
;            C preservado (B e reaproveitado como contador)
; --------------------------------------------------------------------------
send_i2c_block:
    PUSH BC              ; preserva B(quantidade) e C do chamador
    LD   C, A            ; C = control byte

    LD   A, oled
    CALL I2C_Open
    LD   A, C
    CALL I2C_Write        ; control byte enviado uma unica vez
send_i2c_block_loop:
    LD   A, (HL)
    CALL I2C_Write
    INC  HL
    DJNZ send_i2c_block_loop
    CALL I2C_Close

    POP  BC
    RET


; --------------------------------------------------------------------------
; SH1106_FlushBuffer - envia um buffer de RAM (128x64 = 1024 bytes,
; organizado como 8 paginas sequenciais de 128 bytes) para o display
;   Entrada: HL = endereco do buffer
;   Saida:   HL avancado ate o fim do buffer
; Cada pagina e enviada como um unico bloco de 128 bytes.
; --------------------------------------------------------------------------
SH1106_FlushBuffer:
    LD   C, 0             ; contador de paginas
SH1106_FlushPage:
    LD   A, C
    CALL SH1106_SetPage    ; HL preservado

    LD   A, $40            ; control byte: fluxo de dados
    LD   B, SCR_WIDTH
    CALL send_i2c_block    ; envia 128 bytes a partir de HL; HL += 128

    INC  C
    LD   A, C
    CP   SCR_PAGES
    JR   NZ, SH1106_FlushPage

    RET


; --------------------------------------------------------------------------
; Rotinas de baixo nivel I2C (byte unico - usadas so na inicializacao)
; --------------------------------------------------------------------------
send_cmd:
    PUSH AF
    LD   A, oled
    CALL I2C_Open
    LD   A, $00          ; control byte: fluxo de comandos
    CALL I2C_Write
    POP  AF
    CALL I2C_Write
    CALL I2C_Close
    RET

send_data:
    PUSH AF
    LD   A, oled
    CALL I2C_Open
    LD   A, $40          ; control byte: fluxo de dados
    CALL I2C_Write
    POP  AF
    CALL I2C_Write
    CALL I2C_Close
    RET

delay_50ms:
    LD   DE, $0032
    CALL delay
    RET


; --------------------------------------------------------------------------
; Areas auxiliares usadas por send_i2c_block:
; PAGE_CMD - scratch de 3 bytes montado por SH1106_SetPage a cada chamada
; ZERO_ROW - 128 bytes fixos em zero, fonte de dados para SH1106_ClearAll
; --------------------------------------------------------------------------
PAGE_CMD:
    defs 3, $00

ZERO_ROW:
    defs SCR_WIDTH, $00


; --------------------------------------------------------------------------
; Fonte 5x7 completa (ASCII 0x00-0x7E), indexada diretamente pelo codigo
; do caractere (6 bytes por entrada: 5 colunas + 1 de espacamento).
; --------------------------------------------------------------------------
FONT:
	.db 0x00, 0x00, 0x00, 0x00, 0x00, 0x00 ;     0x00 00
	.db 0x00, 0x00, 0x00, 0x00, 0x00, 0x00 ;     0x00 00
	.db 0x00, 0x00, 0x00, 0x00, 0x00, 0x00 ;     0x00 00
	.db 0x00, 0x00, 0x00, 0x00, 0x00, 0x00 ;     0x00 00
	.db 0x00, 0x00, 0x00, 0x00, 0x00, 0x00 ;     0x00 00
	.db 0x00, 0x00, 0x00, 0x00, 0x00, 0x00 ;     0x00 00
	.db 0x00, 0x00, 0x00, 0x00, 0x00, 0x00 ;     0x00 00
	.db 0x00, 0x00, 0x00, 0x00, 0x00, 0x00 ;     0x00 00
	.db 0x00, 0x00, 0x00, 0x00, 0x00, 0x00 ;     0x00 00
	.db 0x00, 0x00, 0x00, 0x00, 0x00, 0x00 ;     0x00 00
	.db 0x00, 0x00, 0x00, 0x00, 0x00, 0x00 ;     0x00 00
	.db 0x00, 0x00, 0x00, 0x00, 0x00, 0x00 ;     0x00 00
	.db 0x00, 0x00, 0x00, 0x00, 0x00, 0x00 ;     0x00 00
	.db 0x00, 0x00, 0x00, 0x00, 0x00, 0x00 ;     0x00 00
	.db 0x00, 0x00, 0x00, 0x00, 0x00, 0x00 ;     0x00 00
	.db 0x00, 0x00, 0x00, 0x00, 0x00, 0x00 ;     0x00 00
	.db 0x00, 0x00, 0x00, 0x00, 0x00, 0x00 ;     0x00 00
	.db 0x00, 0x00, 0x00, 0x00, 0x00, 0x00 ;     0x00 00
	.db 0x00, 0x00, 0x00, 0x00, 0x00, 0x00 ;     0x00 00
	.db 0x00, 0x00, 0x00, 0x00, 0x00, 0x00 ;     0x00 00
	.db 0x00, 0x00, 0x00, 0x00, 0x00, 0x00 ;     0x00 00
	.db 0x00, 0x00, 0x00, 0x00, 0x00, 0x00 ;     0x00 00
	.db 0x00, 0x00, 0x00, 0x00, 0x00, 0x00 ;     0x00 00
	.db 0x00, 0x00, 0x00, 0x00, 0x00, 0x00 ;     0x00 00
	.db 0x00, 0x00, 0x00, 0x00, 0x00, 0x00 ;     0x00 00
	.db 0x00, 0x00, 0x00, 0x00, 0x00, 0x00 ;     0x00 00
	.db 0x00, 0x00, 0x00, 0x00, 0x00, 0x00 ;     0x00 00
	.db 0x00, 0x00, 0x00, 0x00, 0x00, 0x00 ;     0x00 00
	.db 0x00, 0x00, 0x00, 0x00, 0x00, 0x00 ;     0x00 00
	.db 0x00, 0x00, 0x00, 0x00, 0x00, 0x00 ;     0x00 00
	.db 0x00, 0x00, 0x00, 0x00, 0x00, 0x00 ;     0x00 00
	.db 0x00, 0x00, 0x00, 0x00, 0x00, 0x00 ;     0x00 31

    .db 0x00, 0x00, 0x00, 0x00, 0x00, 0x00 ;     0x20 32
    .db 0x00, 0x00, 0x6f, 0x00, 0x00, 0x00 ;   ! 0x21 33
    .db 0x00, 0x07, 0x00, 0x07, 0x00, 0x00 ;   " 0x22 34
    .db 0x14, 0x7f, 0x14, 0x7f, 0x14, 0x00 ;   # 0x23 35
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    .db 0x20, 0x10, 0x08, 0x04, 0x02, 0x00 ;   / 0x2f 47
    .db 0x3e, 0x51, 0x49, 0x45, 0x3e, 0x00 ;   0 0x30 48
    .db 0x00, 0x42, 0x7f, 0x40, 0x00, 0x00 ;   1 0x31 49
    .db 0x42, 0x61, 0x51, 0x49, 0x46, 0x00 ;   2 0x32 50
    .db 0x21, 0x41, 0x45, 0x4b, 0x31, 0x00 ;   3 0x33 51
    .db 0x18, 0x14, 0x12, 0x7f, 0x10, 0x00 ;   4 0x34 52
    .db 0x27, 0x45, 0x45, 0x45, 0x39, 0x00 ;   5 0x35 53
    .db 0x3c, 0x4a, 0x49, 0x49, 0x30, 0x00 ;   6 0x36 54
    .db 0x01, 0x71, 0x09, 0x05, 0x03, 0x00 ;   7 0x37 55
    .db 0x36, 0x49, 0x49, 0x49, 0x36, 0x00 ;   8 0x38 56
    .db 0x06, 0x49, 0x49, 0x29, 0x1e, 0x00 ;   9 0x39 57
    .db 0x00, 0x36, 0x36, 0x00, 0x00, 0x00 ;   : 0x3a 58
    .db 0x00, 0x56, 0x36, 0x00, 0x00, 0x00 ;   ; 0x3b 59
    .db 0x08, 0x14, 0x22, 0x41, 0x00, 0x00 ;   < 0x3c 60
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    .db 0x00, 0x08, 0x36, 0x41, 0x41, 0x00 ;   { 0x7b 123
    .db 0x00, 0x00, 0x7f, 0x00, 0x00, 0x00 ;   | 0x7c 124
    .db 0x41, 0x41, 0x36, 0x08, 0x00, 0x00 ;   } 0x7d 125
    .db 0x04, 0x02, 0x04, 0x08, 0x04, 0x00 ;   ~ 0x7e 126
