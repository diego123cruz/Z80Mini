; **********************************************************************
; **  API - Public functions                                          **
; **********************************************************************

;----------------------------------------------------------------------------------------------------------
;	Display LCD
;----------------------------------------------------------------------------------------------------------
INIT_LCD			        .EQU	$0100			;Initalise the LCD
CLEAR_GBUF			        .EQU	$0103			;Clear the Graphics Buffer
CLEAR_GR_LCD			    .EQU	$0106			;Clear the Graphics LCD Screen
CLEAR_TXT_LCD			    .EQU	$0109			;Clear the Text LCD Screen
SET_GR_MODE			        .EQU	$010C			;Set Graphics Mode
SET_TXT_MODE			    .EQU	$010F			;Set Text Mode
DRAW_BOX			        .EQU	$0112			;Draw a rectangle between two points
DRAW_LINE			        .EQU	$0115			;Draw a line between two points
DRAW_CIRCLE			        .EQU	$0118			;Draw a circle from Mid X,Y to Radius
DRAW_PIXEL			        .EQU	$011B			;Draw one pixel at X,Y
FILL_BOX			        .EQU	$011E			;Draw a filled rectangle between two points
FILL_CIRCLE			        .EQU	$0121			;Draw a filled circle from Mid X,Y to Radius
PLOT_TO_LCD			        .EQU	$0124			;Display the Graphics Buffer to the LCD Screen
PRINT_STRING			    .EQU	$0127			;Print Text on the screen in a given row
PRINT_CHARS			        .EQU	$012A			;Print Characters on the screen in a given row and column
DELAY_US			        .EQU	$012D			;Microsecond delay for LCD updates
DELAY_MS             		.EQU	$0130			;Millisecond delay for LCD updates
SET_BUF_CLEAR			    .EQU	$0133			;Clear the Graphics buffer on after Plotting to the screen
SET_BUF_NO_CLEAR     		.EQU	$0136			;Retain the Graphics buffer on after Plotting to the screen
CLEAR_PIXEL          		.EQU	$0139			;Remove a Pixel at X,Y
FLIP_PIXEL			        .EQU	$013C			;Flip a Pixel On/Off at X,Y
LCD_INST             		.EQU	$013F			;Send a parallel or serial instruction to LCD
LCD_DATA             		.EQU	$0142			;Send a parallel or serial datum to LCD
SER_SYNC             		.EQU	$0145			;Send serial synchronise byte to LCD
DRAW_GRAPHIC         		.EQU	$0148			;Draw an ASCII charcter or Sprite to the LCD
INV_GRAPHIC          		.EQU	$014B			;Inverse graphics printing
INIT_TERMINAL        		.EQU	$014E			;Initialize the LCD for terminal emulation
SEND_CHAR_TO_GLCD    		.EQU	$0151			;Send an ASCII Character to the LCD
SEND_STRING_TO_GLCD 		.EQU	$0154			;Send an ASCII String to the LCD
SEND_A_TO_GLCD       		.EQU	$0157			;Send register A to the LCD
SEND_HL_TO_GLCD      		.EQU	$015A			;Send register HL to the LCD
SET_CURSOR           		.EQU	$015D			;Set the graphics cursor
GET_CURSOR           		.EQU	$0160			;Get the current cursor
DISPLAY_CURSOR       		.EQU	$0163			;Set Cursor on or off
;----------------------------------------------------------------------------------------------------------
;	UTIL
;----------------------------------------------------------------------------------------------------------
H_Delay              		.EQU	$0166			;Delay in milliseconds (DE in millis)
LCD_PRINT_STRING            .EQU    $0169           ;Print string HL, end with 0 EX: "Test", $00
;----------------------------------------------------------------------------------------------------------
;	I2C Board
;----------------------------------------------------------------------------------------------------------
I2C_Open     			    .EQU	$016C			;Start i2c (Device address in A)
I2C_Close             		.EQU	$016F			;Close i2c 
I2C_Read              		.EQU	$0172			;I2C Read (data in A)
I2C_Write 			        .EQU	$0175			;I2C Write (data in A)
I2CLIST                     .EQU    $0178           ;I2C List devices on lcd

; Display oled SSD1306 128x32 ou 128x64
oled    .equ    $78

    .org $8000
    
    

inicio:

    ; display on
    LD a, $AF
    CALL send_cmd
    
    ; set display normal
    LD a, $A6
    CALL send_cmd
    
    ; Page mode
    LD a, $02
    CALL send_cmd
    
    ; Charge Pump
    LD a, $8d
    CALL send_cmd
    LD a, $14
    CALL send_cmd
    

    ; 128x32 - Remover para 128x64
    LD a, $a8
    CALL send_cmd
    LD a, $1f
    CALL send_cmd
    
    ; 128x32 - Remover para 128x64
    LD a, $da
    CALL send_cmd
    LD a, $02
    CALL send_cmd

    ; horizontal
    LD a, $20
    CALL send_cmd
    LD a, $00
    CALL send_cmd
    
    ; col
    LD a, $21
    CALL send_cmd
    LD a, 0
    CALL send_cmd
    LD a, 127
    CALL send_cmd
    
    ; row
    LD a, $22
    CALL send_cmd
    LD a, 0
    CALL send_cmd
    LD a, 3
    CALL send_cmd
    
    
    
    call delay
    
    ;==================

    ; Teste carregamento de imagem por partes de 128x8

    ld b, 128
    ld hl, z1
img:
    ld a, (hl)
    push bc
    push hl
    call send_data
    pop hl
    pop bc
    inc hl
    djnz img


    ld b, 128
    ld hl, z2
img1:
    ld a, (hl)
    push bc
    push hl
    call send_data
    pop hl
    pop bc
    inc hl
    djnz img1
    
    
    ld b, 128
    ld hl, z3
img2:
    ld a, (hl)
    push bc
    push hl
    call send_data
    pop hl
    pop bc
    inc hl
    djnz img2
    
    
    ld b, 128
    ld hl, z4
img3:
    ld a, (hl)
    push bc
    push hl
    call send_data
    pop hl
    pop bc
    inc hl
    djnz img3
    
    

loop:
    IN A, ($40)
    bit 7, a
    call nz, up
    bit 5, a
    call nz, down
    bit 6, a
    call nz, left
    bit 4, a
    call nz, right
    

    JP loop



right:
    ld a, $ff
    call send_data
    ;call delay
    ret
    
left:
    ld a, $00
    call send_data
    ;call delay
    ret
    
down:
    ld a, $F0
    call send_data
    call delay
    ret
    
up:
    ld a, $aa
    call send_data
    call delay
    ret
    

delay:
    LD DE, $0032
    CALL H_Delay
    Ret



send_cmd:
    PUSH AF
    LD A, oled
    CALL I2C_Open
    LD A, $00 ; Commands
    CALL I2C_Write
    POP AF
    CALL I2C_Write
    CALL I2C_Close
    ret


send_data:
    PUSH AF
    LD A, oled
    CALL I2C_Open
    LD A, $40 ; Dados
    CALL I2C_Write
    POP AF
    CALL I2C_Write
    CALL I2C_Close
    ret
    
    

z1: .db 0x00, 0x00, 0x00, 0x00, 0x00, 0x00, 0x00, 0x00, 0x00, 0x00, 0x00, 0x00, 0x00, 0x00, 0x00, 0x00
.db 0x00, 0x00, 0x00, 0x00, 0x00, 0x00, 0x00, 0x00, 0x00, 0x00, 0x00, 0x00, 0x00, 0x00, 0x00, 0x00
.db 0x00, 0x00, 0x00, 0x00, 0x00, 0x00, 0x00, 0x00, 0x00, 0x00, 0x00, 0x00, 0x00, 0x00, 0x00, 0x00
.db 0x00, 0x00, 0x00, 0x00, 0x00, 0x00, 0x00, 0x00, 0x00, 0x00, 0x00, 0x00, 0x00, 0x00, 0x00, 0x00
.db 0x00, 0x00, 0x00, 0x00, 0x00, 0x00, 0x00, 0x00, 0x00, 0x00, 0x00, 0x00, 0x00, 0x00, 0x00, 0x00
.db 0x00, 0x00, 0x00, 0x00, 0x00, 0x00, 0x00, 0x00, 0x00, 0x00, 0x00, 0xC0, 0x20, 0x10, 0x10, 0x10
.db 0x20, 0x00, 0x00, 0x00, 0xC0, 0x30, 0xC0, 0x00, 0x00, 0x00, 0xF0, 0x30, 0xC0, 0x00, 0x00, 0x00
.db 0xC0, 0x30, 0xF0, 0x00, 0x00, 0xF0, 0x90, 0x90, 0x90, 0x00, 0x00, 0x00, 0x00, 0x00, 0x00, 0x00

z2: .db 0x00, 0x03, 0x03, 0x03, 0x83, 0xC3, 0xF3, 0x3B, 0x1F, 0x07, 0x00, 0x00, 0x00, 0x3C, 0x7E, 0xE7
.db 0xC3, 0xC3, 0xE7, 0x3E, 0x1E, 0x00, 0x00, 0x00, 0xF0, 0xFC, 0x0E, 0x03, 0x03, 0x03, 0x03, 0x0E
.db 0xFE, 0xF8, 0x00, 0x00, 0x00, 0x00, 0x00, 0x00, 0x00, 0x00, 0xFF, 0xFF, 0x07, 0x3E, 0xF8, 0xC0
.db 0x00, 0x00, 0x00, 0x00, 0xC0, 0xF8, 0x1E, 0x07, 0xFF, 0xFF, 0x00, 0x00, 0x00, 0x00, 0x00, 0xF3
.db 0xF3, 0x00, 0x00, 0x00, 0x00, 0xF0, 0xF0, 0x60, 0x30, 0x30, 0x30, 0x70, 0xE0, 0xC0, 0x00, 0x00
.db 0x00, 0x00, 0xF3, 0xF3, 0x00, 0x00, 0x00, 0x00, 0x00, 0x00, 0x00, 0x03, 0x04, 0x08, 0x09, 0x09
.db 0x07, 0x00, 0x0C, 0x03, 0x02, 0x02, 0x02, 0x03, 0x0C, 0x00, 0x0F, 0x00, 0x00, 0x03, 0x0C, 0x03
.db 0x00, 0x00, 0x0F, 0x00, 0x00, 0x0F, 0x08, 0x08, 0x08, 0x00, 0x00, 0x00, 0x00, 0x00, 0x00, 0x00

z3: .db 0x00, 0x70, 0x7C, 0x6E, 0x67, 0x61, 0x60, 0x60, 0x60, 0x60, 0x60, 0x00, 0x1C, 0x3E, 0x73, 0x61
.db 0x60, 0x60, 0x61, 0x73, 0x3F, 0x1E, 0x00, 0x00, 0x0F, 0x3F, 0x38, 0x60, 0x60, 0x60, 0x60, 0x38
.db 0x1F, 0x07, 0x00, 0x00, 0x00, 0x00, 0x00, 0x00, 0x00, 0x00, 0x7F, 0x7F, 0x00, 0x00, 0x00, 0x07
.db 0x1F, 0x78, 0x78, 0x1F, 0x07, 0x00, 0x00, 0x00, 0x7F, 0x7F, 0x00, 0x00, 0x00, 0x00, 0x00, 0x7F
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.db 0x00, 0x00, 0x00, 0x00, 0x00, 0x00, 0x00, 0x00, 0x00, 0x00, 0x00, 0x00, 0x00, 0x00, 0x00, 0x00

z4: .db 0x00, 0x00, 0x00, 0x00, 0x00, 0x00, 0x00, 0x00, 0x00, 0x00, 0x00, 0x00, 0x00, 0x00, 0x00, 0x00
.db 0x00, 0x00, 0x00, 0x00, 0x00, 0x00, 0x00, 0x00, 0x00, 0x00, 0x00, 0x00, 0x00, 0x00, 0x00, 0x00
.db 0x00, 0x00, 0x00, 0x00, 0x00, 0x00, 0x00, 0x00, 0x00, 0x00, 0x00, 0x00, 0x00, 0x00, 0x00, 0x00
.db 0x00, 0x00, 0x00, 0x00, 0x00, 0x00, 0x00, 0x00, 0x00, 0x00, 0x00, 0x00, 0x00, 0x00, 0x00, 0x00
.db 0x00, 0x00, 0x00, 0x00, 0x00, 0x00, 0x00, 0x00, 0x00, 0x00, 0x00, 0x00, 0x00, 0x00, 0x00, 0x00
.db 0x00, 0x00, 0x00, 0x00, 0x00, 0x00, 0x00, 0x00, 0x00, 0x00, 0x00, 0x01, 0x02, 0x04, 0x04, 0x04
.db 0x02, 0x00, 0x01, 0x02, 0x04, 0x04, 0x04, 0x02, 0x01, 0x00, 0x00, 0x07, 0x00, 0x00, 0x01, 0x06
.db 0x00, 0x00, 0x07, 0x04, 0x04, 0x04, 0x00, 0x00, 0x00, 0x00, 0x00, 0x00, 0x00, 0x00, 0x00, 0x00








    